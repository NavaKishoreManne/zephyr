## subsys/scsi/Kconfig
```kconfig
# Copyright (c) 2026 Advanced Micro Devices, Inc.
# SPDX-License-Identifier: Apache-2.0

# SCSI mid-layer configuration
# Transport-neutral command execution, sense handling, and device probe.
# Transports (e.g. USB MSC host) implement scsi_driver_api.

menuconfig SCSI
	bool "SCSI mid-layer"
	help
	  Transport-neutral SCSI command execution, sense handling, and device
	  probe. Bus drivers implement scsi_driver_api and bind struct scsi_device.

if SCSI

config SCSI_TUR_RETRY_COUNT
	int "TEST UNIT READY retries during probe"
	default 5
	help
	  Number of times to retry TEST UNIT READY when the device returns
	  NOT READY (typical for removable media after insertion).

config SCSI_TUR_RETRY_DELAY_MS
	int "Delay between TEST UNIT READY retries (ms)"
	default 100
	help
	  Milliseconds to wait between TEST UNIT READY retries during probe.

config SCSI_SYNC_CACHE_RETRY_COUNT
	int "SYNCHRONIZE CACHE retries on I/O error"
	default 5
	help
	  Number of times to retry SCSI SYNCHRONIZE CACHE (10) when the device
	  returns CHECK CONDITION or a transport I/O error. Some USB thumb
	  drives briefly stall on cache flush; retries improve FatFs fs_sync().

config SCSI_SYNC_CACHE_RETRY_DELAY_MS
	int "Delay between SYNCHRONIZE CACHE retries (ms)"
	default 100
	help
	  Milliseconds to wait between SYNCHRONIZE CACHE retries.

config SCSI_SYNC_CACHE_BEST_EFFORT
	bool "Treat SYNCHRONIZE CACHE failure as success"
	default y
	help
	  Many USB thumb drives STALL or return CSW PHASE_ERR / CHECK
	  CONDITION for SYNCHRONIZE CACHE(10) even when writes already
	  reached the medium. When enabled, scsi_synchronize_cache_10()
	  returns success after retries are exhausted so FatFs fs_sync()
	  and ``msc write`` complete without spurious I/O errors.

config SCSI_WRITE_PROTECT_DETECT
	bool "Probe write protect with MODE SENSE(6) during device probe"
	default n
	help
	  When enabled, scsi_device_probe() issues MODE SENSE(6) (page 0x3f,
	  192-byte allocation) to read the device-specific write-protect bit.
	  Matches the allocation Linux sd uses for USB mass-storage.

	  Many USB thumb drives mishandle short or non-standard MODE SENSE
	  requests (stall, phase error). Leave this disabled unless you need
	  write-protect reporting; the device is then assumed writable (same
	  as Linux usb-storage without CONFIG_USB_STORAGE_RW_DETECT).

# Define the SCSI subsystem as a module
module = SCSI
module-str = scsi

# Include additional logging configuration for SCSI subsystem
source "subsys/logging/Kconfig.template.log_config"

endif # SCSI
```

## subsys/usb/host/Kconfig
```kconfig
# Copyright (c) 2022 Nordic Semiconductor ASA
#
# SPDX-License-Identifier: Apache-2.0

menuconfig USB_HOST_STACK
	bool "USB host stack [EXPERIMENTAL]"
	select EXPERIMENTAL
	select UHC_DRIVER
	help
	  New experimental USB host stack.

if USB_HOST_STACK

module = USBH
module-str = usbh
source "subsys/logging/Kconfig.template.log_config"

config USBH_USB_DEVICE_MAX
	int "Maximum number of USB devices supported."
	default 4
	range 2 127
	help
	  Maximum number of USB devices supported for all controllers.

config USBH_USB_DEVICE_HEAP
	int "Memory used to cache device descriptors"
	default 1024
	range 256 16384
	help
	  Memory used to cache device descriptors.

config USBH_SHELL
	bool "USB host shell"
	depends on SHELL
	help
	  Shell commands for USB host support.

config USBH_INIT_PRIO
	int
	default 90
	help
	  USB host thread initialization priority level.

config USBH_MAX_UHC_MSG
	int "Maximum number of UHC events"
	default 10
	help
	  Maximum number of UHC events that can be queued.

rsource "Kconfig.usbip"
rsource "class/Kconfig"

config USBH_STACK_SIZE
	int "USB host stack thread stack size"
	default 1024
	help
	  Stack size in bytes for the USB host worker threads (main and bus).

config USBH_USB2_ENUM_SCHEME
	bool "USB2 enumeration (64-byte GET_DESCRIPTOR before SET_ADDRESS)"
	default n
	help
	  USB2 enumeration order in usbh_device_init() with optional xHCI
	  uhc_assign_address instead of legacy SET_ADDRESS.

config USBH_USB2_ENUM_SECOND_RESET
	bool "Second bus reset after first GET_DESCRIPTOR"
	default n
	depends on USBH_USB2_ENUM_SCHEME

config USBH_POST_SET_ADDRESS_MS
	int "Milliseconds to delay after SET_ADDRESS"
	default 10
	range 0 500
	depends on USBH_USB2_ENUM_SCHEME

config USBH_GET_DESCRIPTOR_TRIES
	int "GET_DESCRIPTOR retry count"
	default 2
	range 1 5
	depends on USBH_USB2_ENUM_SCHEME

config USBH_SET_ADDRESS_TRIES
	int "SET_ADDRESS retry count"
	default 2
	range 1 5
	depends on USBH_USB2_ENUM_SCHEME

config USBH_ENUM_RETRY_DELAY_MS
	int "Milliseconds between GET_DESCRIPTOR retries"
	default 100
	range 0 500
	depends on USBH_USB2_ENUM_SCHEME

config USBH_SET_ADDRESS_RETRY_DELAY_MS
	int "Milliseconds between SET_ADDRESS retries"
	default 200
	range 0 500
	depends on USBH_USB2_ENUM_SCHEME

config USBH_POST_SET_CONFIGURATION_MS
	int "Milliseconds to delay after SET_CONFIGURATION before full cfg read"
	default 0
	range 0 500

endif # USB_HOST_STACK
```

## subsys/usb/host/class/Kconfig.hub
```kconfig
# Copyright (c) 2026 Advanced Micro Devices, Inc.
# SPDX-License-Identifier: Apache-2.0

config USBH_HUB
	bool "USB hub Chapter 11 request helpers"
	default n
	help
	  Hub class control requests (port status, set/clear feature, hub
	  descriptor) used by the hub host class driver and shell helpers.

config USBH_HUB_CLASS
	bool "USB hub host class driver"
	depends on USBH_HUB
	default y
	help
	  Register a USB host class instance for USB hub devices. Powers
	  downstream ports, listens on the hub status interrupt endpoint, and
	  enumerates newly connected devices.

if USBH_HUB_CLASS

config USBH_HUB_PORT_RESET_MS
	int "Milliseconds to wait during hub port reset"
	default 50
	range 10 500
	help
	  Delay after SET_FEATURE(PORT_RESET) before polling for C_PORT_RESET.

config USBH_HUB_MAX_PORTS
	int "Maximum downstream ports supported by the hub class driver"
	default 8
	range 1 15
	help
	  Size of the hub status-change bitmap and port scan loops.

endif # USBH_HUB_CLASS
```

## tests/drivers/usb/uhc/xhci_bulk/boards/native_sim.native_64.conf
```kconfig
# Copyright (c) 2026
# SPDX-License-Identifier: Apache-2.0

CONFIG_SRAM_BASE_ADDRESS=0
CONFIG_SRAM_SIZE=262144
```
